## src/meta-uav/conf/distro/commons.conf
```bitbake
require conf/distro/poky.conf

# Add these binaries to the HOSTTOOLS_NONFATAL variable to allow them to
# be called from within the recipe build task. They are specified as
# NONFATAL as they are not installed at the same time on the build
# system.
HOSTTOOLS_NONFATAL += "sudo"

# Inherit from poky

## Mandatory features

DISTRO_FEATURES = "bash ipv4 ipv6 systemd wifi"

## Optional features, check if needed
DISTRO_FEATURES += "ipsec"

# XXX: Development only?
DISTRO_FEATURES += "usbhost"

# XXX: Development only?
DISTRO_FEATURES += "keyboard"

# Discarded features
DISTRO_FEATURES:remove = "alsa"
DISTRO_FEATURES:remove = "cramfs"
DISTRO_FEATURES:remove = "directfb"
DISTRO_FEATURES:remove = "ext2"
DISTRO_FEATURES:remove = "irda"
DISTRO_FEATURES:remove = "nfc"
DISTRO_FEATURES:remove = "opengl"
DISTRO_FEATURES:remove = "pcmcia"
DISTRO_FEATURES:remove = "ptest"
DISTRO_FEATURES:remove = "usbgadget"
DISTRO_FEATURES:remove = "wayland"
DISTRO_FEATURES:remove = "x11"

# See https://www.yoctoproject.org/docs/3.1/ref-manual/ref-manual.html#migration-3.0-init-system-selection
# See also meta/conf/distro/include/init-manager-systemd.inc
INIT_MANAGER = "systemd"
```

## src/meta-uav/conf/layer.conf
```bitbake
# We have a conf and classes directory, add to BBPATH
BBPATH .= ":${LAYERDIR}"

# We have recipes-* directories, add to BBFILES
BBFILES += "${LAYERDIR}/recipes-*/*/*.bb \
            ${LAYERDIR}/recipes-*/*/*.bbappend"

BBFILE_COLLECTIONS += "meta-uav"
BBFILE_PATTERN_meta-uav = "^${LAYERDIR}/"
BBFILE_PRIORITY_meta-uav = "6"

LAYERDEPENDS_meta-uav = "core"
LAYERSERIES_COMPAT_meta-uav = "#-REF_SPEC-#"

# See https://www.yoctoproject.org/docs/3.1/ref-manual/ref-manual.html#var-BBFILES_DYNAMIC
BBFILES_DYNAMIC += ""
```
